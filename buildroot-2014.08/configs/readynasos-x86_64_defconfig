## linux-3.0.101-0.46/arch/arm/mach-armadaxp/Kconfig
```kconfig
if ARCH_ARMADA_XP

config  MV_HAL_RULES_PATH
        string "path of the mvRules.mk file for HAL drivers"
        default "arch/arm/mach-armadaxp/mv_hal_support/mvRules.mk"
        ---help---

#source "arch/arm/plat-orion/mv_hal_drivers/Kconfig"

menu "Marvell Armada Options"

config ARMADA_XP
	bool "Armada XP SoC Family"
	default y

choice
	prompt "Armada XP Chip revision"
	depends on ARMADA_XP
	default ARMADA_XP_REV_Z1

config  ARMADA_XP_REV_Z1
	bool "MV88F78x30 and MV88F78x60 Z1 SoC devices"
	select ARMADA_XP_DEEP_IDLE_L2_WA
	select ARMADA_XP_DEEP_IDLE_UNMASK_INTS_WA
	select ARMADA_XP_Z1_DEEP_IDLE_WA
	select SHEEVA_ERRATA_ARM_CPU_4742
	select SHEEVA_ERRATA_ARM_CPU_4786 if (ARM_THUMB && VFP)
#	select SHEEVA_ERRATA_ARM_CPU_5315
	select SHEEVA_ERRATA_ARM_CPU_4413
	select SHEEVA_ERRATA_ARM_CPU_4659
	select SHEEVA_ERRATA_ARM_CPU_5114 if (CPU_SHEEVA_PJ4B_V6 && AURORA_IO_CACHE_COHERENCY)
	select SHEEVA_ERRATA_ARM_CPU_4611
#	select SHEEVA_ERRATA_ARM_CPU_4948
	select SHEEVA_ERRATA_ARM_CPU_BTS61 if (SMP || AURORA_IO_CACHE_COHERENCY)
	---help---
	Choosing this option will generate a linux kernel for the
	  MV78x30 and MV78x60 devices with revision Z1

config  ARMADA_XP_KW40_REV_A0
	bool "MV88F6710 A0 SoC devices"
	select SHEEVA_ERRATA_ARM_CPU_5114 if (CPU_V6)
	---help---
	Choosing this option will generate a linux kernel for the
	  MV88F6710 (KW40) devices with revision A0

config  ARMADA_XP_REV_A0
	bool "MV88F78x30 and MV88F78x60 A0 SoC devices"
	---help---
	Choosing this option will generate a linux kernel for the
	  MV78x30 and MV78x60 devices with revision A0

endchoice

config MACH_ARMADA_XP_DB
	bool "Marvell Armada XP Development Board"
	default y
	help

config MACH_ARMADA_XP_RDSRV
	bool "Marvell Armada XP Server Board"
	default y
	help

config MACH_ARMADA_XP_FPGA
	bool "Marvell Armada XP FPGA Board"
	depends on !MACH_ARMADA_XP_DB && !MACH_ARMADA_XP_RDSRV
	default y
	help

config CFU_DRAM_BYPASS
        bool "Bypass CFU to DRAM via Punit"
	default n
	help

endmenu

endif
```

## linux-3.0.101-0.46/arch/arm/plat-armada/Kconfig
```kconfig
if PLAT_ARMADA

menu "Armada SoC options"
	depends on PLAT_ARMADA

config JTAG_DEBUG
        bool "Enable JTAG by disable \"wait for interrupt\"."
	depends on MV88F6500 || MV88F6281 || MV78XX0
        default n
        ---help---
           Enable the JTAG debugger taking over the CPU by disabling "wait for interrupt" idle loop."


menu "Armada SoC Included Features"

config MV_INCLUDE_PEX
	bool "PCI Express Support"
	depends on PCI && (MV88F6500 || MV88F6281 || MV78XX0 || ARMADA_XP || ARMADA_370)
	default y
        ---help---
        Please don't change this configs unless you know what you are doing.

config MV_INCLUDE_PCI
	bool "PCI Support"
	depends on PCI && (MV88F6500 || MV88F6281 || MV78XX0 || ARMADA_XP || ARMADA_370)
	default n
        ---help---
        Please don't change this configs unless you know what you are doing.

config MV_INCLUDE_USB
	bool "USB Support"
	depends on MV88F6500 || MV88F6281 || MV78XX0 || ARMADA_XP || ARMADA_370
	default y
        ---help---
        Please don't change this configs unless you know what you are doing.

config MV_INCLUDE_XOR
	bool "XOR Support"
	depends on MV88F6500 || MV88F6281 || MV78XX0 || ARMADA_XP || ARMADA_370
	default y
        ---help---
        Please don't change this configs unless you know what you are doing.

config MV_INCLUDE_CESA
	bool "CESA Support"
	depends on MV88F6500 || MV88F6082 || MV88F6183 || MV88F6281 || MV78XX0 || ARMADA_XP || ARMADA_370
	default y
        ---help---
        Please don't change this configs unless you know what you are doing.

config MV_INCLUDE_NFC
	bool "Nand Flash Controller Support"
	depends on MV88F6500 || ARMADA_XP || ARMADA_370
	default y
        ---help---
        Please don't change this configs unless you know what you are doing.

config MV_INCLUDE_LEGACY_NAND
	bool "Legacy NAND Support"
	depends on MV88F6500 || MV88F6281 || MV78XX0 || ARMADA_XP
	default y
        ---help---
        Please don't change this configs unless you know what you are doing.

config MV_INCLUDE_INTEG_SATA
	bool "Integrated SATA Support"
	depends on MV88F6500 || MV88F6281 || MV78XX0 || ARMADA_XP || ARMADA_370
	default y
        ---help---
        Please don't change this configs unless you know what you are doing.

config MV_INCLUDE_TDM
	bool "Integrated TDM Support"
	depends on MV88F6500 || MV88F6281 || MV78XX0 || ARMADA_XP || ARMADA_370
	default y
        ---help---
        Please don't change this configs unless you know what you are doing.

config MV_INCLUDE_GIG_ETH
	bool "Giga Ethernet Support"
	depends on MV88F6500 || MV88F6281 || MV78XX0 || ARMADA_XP || ARMADA_370
	default y

config MV_INCLUDE_SPI
	bool "SPI Support"
	depends on MV88F6500 || MV88F6281 || (MV78XX0 && !MV78XX0_Z0) || ARMADA_XP || ARMADA_370
	default y
        ---help---
        Please don't change this configs unless you know what you are doing.

config MV_INCLUDE_SDIO
	bool "SDIO Support"
	depends on MV88F6500 || MV88F6281 || ARMADA_XP || ARMADA_370
	default y
        ---help---
        Please don't change this configs unless you know what you are doing.

config MV_INCLUDE_AUDIO
	bool "Audio Support"
	depends on MV88F6183 || MV88F6281
	default y
        ---help---
        Please don't change this configs unless you know what you are doing.

config MV_INCLUDE_TS
	bool "TSU Support"
	depends on MV88F6500 || MV88F6281
	default n
        ---help---
        Please don't change this configs unless you know what you are doing.

config MV_INCLUDE_PON
	bool "PON Support"
	depends on MV88F6500
	default y
        ---help---
        Please don't change this configs unless you know what you are doing.

config MV_INCLUDE_SWITCH
        bool "Ethernet Switch Support"
        depends on MV88F6500 || MV88F6281 || MV78XX0 || ARMADA_XP || ARMADA_370
        default y

endmenu

config MV_GPP_MAX_PINS
	int
	default 32 if MV78XX0
	default 64 if MV88F6281
	default 70 if MV88F6500
	default 67 if ARMADA_XP
	default 67 if ARMADA_370

config MV_DCACHE_SIZE
	hex
	default 0x8000 if MV78XX0 || ARMADA_XP || ARMADA_370
	default 0x4000 if MV88F6500 || MV88F6281

config MV_ICACHE_SIZE
	hex
	default 0x8000 if MV78XX0 || ARMADA_XP || ARMADA_370
	default 0x4000 if MV88F6500 || MV88F6281

menu "Armada SoC MTD support"

config MV_INCLUDE_SFLASH_MTD
    bool "Marvell support for MTD SPI flash device"
    depends on MTD && MV_INCLUDE_SPI
	default y

config MV_SPI_BOOT
	bool "Marvell boot support from MTD SPI device"
	depends on MV_INCLUDE_SFLASH_MTD
	default n
	---help---
	Choose this option if SPI MTD is the system boot device.
	This option controls the various flash types support in the board
	device chip-select information structure under mvBoardEnvSpec.c

choice
	prompt "NAND/NOR Flash Support"
	depends on MTD
	default MTD_NAND_NFC

config MV_INCLUDE_NORFLASH_MTD
    bool "Marvell support for MTD NOR flash device"
    depends on MTD_CFI

config MV_INCLUDE_MFLASH_MTD
    bool "Marvell support for MTD Marvell flash device"
    depends on MTD && MV_INCLUDE_INTEG_MFLASH && !ARMADA_XP

config MTD_NAND_LNC
	bool "MTD driver for the Legacy NAND controller"
	depends on MTD && MV_INCLUDE_LEGACY_NAND

config MTD_NAND_LNC_BOOT
	bool "Marvell boot support from MTD NAND device"
	depends on MTD_NAND_LNC
	default n
	---help---
	Choose this option if NAND MTD is the system boot device.
	This option controls the various flash types support in the board
	device chip-select information structure under mvBoardEnvSpec.c

config MTD_NAND_LNC_RS_ECC
	bool "Support Reed-Solomon 4-bit ECC algorithm for Legacy Nand Controller"
	depends on MTD_NAND_LNC
	default n
	---help---
	Choose this option to support Reed-Solomon 4-bit ECC algorithm.
	Note this option also requires support by low-level boot loader.

config MTD_NAND_LNC_8BYTE_READ
	bool "Support 8B burst Read for Legacy Nand Controller"
	depends on MTD_NAND_LNC
	default n
	---help---
	Choose this option to support NAND 8 Byte Read burst algorithm.

config MTD_NAND_NFC
        tristate "MTD driver for the Armada Nand Flash Controller"
        depends on MTD_NAND && MV_INCLUDE_NFC
        help
          This enables the driver for the NAND flash controller found in
          the Marvell Armada SoC devices.

config MTD_NAND_NFC_GANG_SUPPORT
        bool "NAND Ganged mode support for the NFC"
        depends on MTD_NAND_NFC
	default y
        help
          This option enables the support for 2x8bit ganged mode in
          Marvell's NFC HAL driver and the MTD stack.

config MTD_NAND_NFC_MLC_SUPPORT
        bool "NAND MLC devices support for the NFC"
        depends on MTD_NAND_NFC
	default y
	help
          This option allows support for Nand devices with non-standard
          page/oob layout. These devices are detected incorrectly with
          standard autodetection mechanism based on the READ_ID command.

endchoice

endmenu

choice
	prompt "SoC USB Mode"
	depends on MV_INCLUDE_USB
	default MV_USB_HOST

config MV_USB_HOST
	bool "Support for USB Host"
	---help---
	Choosing this option will configure on chip USB Controller to work in Host mode

config MV_USB_DEVICE
	bool "Support for USB Device"
	---help---
	Choosing this option will configure on chip USB Controller to work in Device mode
endchoice


config ARCH_SUPPORTS_BIG_ENDIAN
	bool
	default y

config  FEROCEON_PROC
	bool "Support for MV-shell proc file system"
	depends on PROC_FS
	---help---
	  Choosing this option will enable you to use the MV-shell through the Proc
	  File system.
	  The MV-shell is a debug utility which can be run from the shell.

config  MV_PMU_PROC
        bool "Support procfs control on Power-Management features"
        depends on PROC_FS
        ---help---
          Choose this option to enable control over the power-management features through
          the proc file-system.

config  MV_DBG_TRACE
	bool "Enable tracing utility"
	default n
	---help---
	  Choosing this debug option will cause some kernel modules to log operations into
	  a cyclic buffer and dump them on failures. Enabling this feature decreases performance.

config  MV_CPU_PERF_CNTRS
        bool "CPU Performance counters support"
        default n
        ---help---
        Choosing this option will enable you to use CPU Performance counters

config  MV_CPU_L2_PERF_CNTRS
        bool "CPU L2 Performance counters support"
        default n
        ---help---
        Choosing this option will enable you to use CPU L2 Performance counters

menu "Soc DMA accelerations"

source arch/arm/plat-armada/mv_drivers_lsp/mv_xor/Kconfig

source arch/arm/plat-armada/mv_drivers_lsp/mv_dma/Kconfig

endmenu


menu "SoC Networking support"
depends on MV_INCLUDE_GIG_ETH

config MV_ETHERNET
        bool "Networking support"
	depends on MV_INCLUDE_GIG_ETH
	default y
        ---help---
        Choose this option to support Marvell Gigabit Ethernet Controller

if MV_ETHERNET

choice
        prompt "GbE Mode"
        depends on MV_INCLUDE_GIG_ETH
        default MV_ETH_NETA

config MV_ETH_LEGACY
        bool "Legacy mode "
        ---help---

config MV_ETH_NETA
        bool "Acceleration mode "
	depends on ARCH_FEROCEON_KW2 || ARCH_ARMADA_XP || ARCH_ARMADA370
        ---help---

endchoice


if MV_ETH_LEGACY
source arch/arm/plat-armada/mv_drivers_lsp/mv_network/Kconfig
endif

if MV_ETH_NETA
source arch/arm/plat-armada/mv_drivers_lsp/mv_neta/Kconfig
endif

endif # MV_ETHERNET
endmenu # "SoC Networking support"

source arch/arm/plat-armada/mv_drivers_lsp/mv_cesa/Kconfig

source arch/arm/plat-armada/mv_drivers_lsp/mv_phone/Kconfig


#source arch/arm/plat-armada/mv_drivers_lsp/mv_sdio/Kconfig

source arch/arm/plat-armada/mv_drivers_lsp/mv_tsu/Kconfig

source arch/arm/plat-armada/mv_drivers_lsp/mv_pon/Kconfig


config  SCSI_MVSATA
	tristate "Support for Marvell Sata Adapters"
	depends on ( MV_INCLUDE_INTEG_SATA && SCSI ) || ( PCI && SCSI )
	---help---
	  Choosing this option will enable you to use the Marvell Sata
	  adapters support with emulation as SCSI adapters.
	  Note that the kernel scsi subsystem must be chosen too.

source arch/arm/plat-armada/mv_drivers_lsp/mv_sata/Kconfig

config PCIE_VIRTUAL_BRIDGE_SUPPORT
        bool "Enable virtual bridge on PCIe"
        depends on PCI
        ---help---
        Enable virtual bridge module to support PCIe switches

config MV_UART_POLLING_MODE
        bool "Enable Polling mode for UART driver"
        depends on ARCH_FEROCEON_KW2
	default y
        ---help---
        Configure UART driver to work in polling mode.

config MV_MMC_TIMEOUT_OVERRIDE
        bool "Override Marvell MMC/SDIO driver default Rd/Wr timeout value"
        depends on MMC
	default y
        ---help---
        Override Marvell MMC/SDIO driver default Rd/Wr timeout value,
	to overcome problematic cards.

endmenu


endif
```
