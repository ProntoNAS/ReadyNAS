## linux-4.1.27-alpine/arch/arm/configs/alpine_defconfig
```kconfig
# CONFIG_LOCALVERSION_AUTO is not set
CONFIG_SYSVIPC=y
CONFIG_POSIX_MQUEUE=y
CONFIG_FHANDLE=y
CONFIG_NO_HZ=y
CONFIG_HIGH_RES_TIMERS=y
CONFIG_IKCONFIG=y
CONFIG_IKCONFIG_PROC=y
CONFIG_CGROUPS=y
CONFIG_BLK_DEV_INITRD=y
CONFIG_EXPERT=y
CONFIG_SYSCTL_SYSCALL=y
CONFIG_SLAB=y
CONFIG_PROFILING=y
CONFIG_MODULES=y
CONFIG_BLK_DEV_INTEGRITY=y
CONFIG_PARTITION_ADVANCED=y
CONFIG_LDM_PARTITION=y
CONFIG_ARCH_ALPINE=y
CONFIG_ARCH_VEXPRESS=y
CONFIG_ARM_LPAE=y
CONFIG_PCI_IOV=y
CONFIG_PCI_INTERNAL_ALPINE=y
CONFIG_PCI_EXTERNAL_ALPINE=y
CONFIG_SMP=y
CONFIG_AEABI=y
CONFIG_HIGHMEM=y
CONFIG_TRANSPARENT_HUGEPAGE=y
# CONFIG_SUSPEND is not set
CONFIG_NET=y
CONFIG_PACKET=y
CONFIG_UNIX=y
CONFIG_XFRM_USER=y
CONFIG_NET_KEY=y
CONFIG_INET=y
CONFIG_IP_MULTICAST=y
CONFIG_IP_PNP=y
CONFIG_IP_PNP_BOOTP=y
CONFIG_INET_AH=y
CONFIG_INET_ESP=y
# CONFIG_INET_DIAG is not set
# CONFIG_IPV6 is not set
CONFIG_NETFILTER=y
CONFIG_NF_CONNTRACK=y
CONFIG_NF_CONNTRACK_IPV4=y
CONFIG_IP_NF_IPTABLES=y
CONFIG_IP_NF_FILTER=y
CONFIG_IP_NF_NAT=y
CONFIG_IP_NF_TARGET_MASQUERADE=y
CONFIG_BRIDGE=y
CONFIG_DEVTMPFS=y
CONFIG_DEVTMPFS_MOUNT=y
CONFIG_MTD=y
CONFIG_MTD_NAND=y
CONFIG_MTD_NAND_AL=y
CONFIG_MTD_UBI=y
# CONFIG_BLK_DEV is not set
CONFIG_RAID_ATTRS=y
CONFIG_BLK_DEV_SD=y
CONFIG_SCSI_SAS_ATTRS=y
CONFIG_SCSI_MPT2SAS=m
CONFIG_ATA=y
# CONFIG_SATA_PMP is not set
CONFIG_SATA_AHCI=y
CONFIG_SATA_AHCI_PLATFORM=y
CONFIG_AHCI_ALPINE=y
CONFIG_SATA_SIL24=m
CONFIG_SATA_MV=y
CONFIG_MD=y
CONFIG_MD_RAID0=y
CONFIG_BLK_DEV_DM=y
CONFIG_DM_CRYPT=y
CONFIG_DM_RAID=y
CONFIG_DM_MULTIPATH=y
CONFIG_DM_UEVENT=y
CONFIG_TARGET_CORE=m
CONFIG_ISCSI_TARGET=m
CONFIG_NETDEVICES=y
CONFIG_BONDING=m
CONFIG_NET_TEAM=m
CONFIG_NET_TEAM_MODE_BROADCAST=m
CONFIG_NET_TEAM_MODE_ROUNDROBIN=m
CONFIG_NET_TEAM_MODE_RANDOM=m
CONFIG_NET_TEAM_MODE_ACTIVEBACKUP=m
CONFIG_NET_TEAM_MODE_LOADBALANCE=m
CONFIG_NET_AL_ETH=y
CONFIG_E100=m
CONFIG_E1000=m
CONFIG_E1000E=m
CONFIG_IGB=m
CONFIG_IGBVF=m
CONFIG_IXGBE=m
CONFIG_IXGBEVF=m
CONFIG_AT803X_PHY=y
CONFIG_INPUT_EVDEV=y
# CONFIG_SERIO_SERPORT is not set
CONFIG_SERIO_AMBAKMI=y
CONFIG_LEGACY_PTY_COUNT=16
CONFIG_SERIAL_8250=y
CONFIG_SERIAL_8250_CONSOLE=y
CONFIG_SERIAL_8250_RUNTIME_UARTS=1
CONFIG_SERIAL_8250_EXTENDED=y
CONFIG_SERIAL_8250_MANY_PORTS=y
CONFIG_SERIAL_8250_SHARE_IRQ=y
CONFIG_SERIAL_8250_RSA=y
CONFIG_SERIAL_8250_DW=y
CONFIG_SERIAL_OF_PLATFORM=y
CONFIG_HW_RANDOM=y
CONFIG_I2C=y
CONFIG_I2C_MUX=y
CONFIG_I2C_MUX_PCA9541=y
CONFIG_I2C_MUX_PCA954x=y
CONFIG_I2C_DESIGNWARE_PLATFORM=y
# CONFIG_HWMON is not set
CONFIG_THERMAL=y
CONFIG_AL_THERMAL=y
CONFIG_USB=y
CONFIG_USB_XHCI_HCD=y
CONFIG_USB_EHCI_HCD=y
CONFIG_USB_EHCI_HCD_PLATFORM=y
CONFIG_USB_OHCI_HCD=y
CONFIG_DMADEVICES=y
CONFIG_DMADEVICES_DEBUG=y
CONFIG_DMADEVICES_VDEBUG=y
CONFIG_ASYNC_TX_DMA=y
CONFIG_DMATEST=y
CONFIG_AL_DMA=y
CONFIG_AL_DMA_STATS=y
CONFIG_AL_DMA_PCI_IOV=y
CONFIG_UIO=y
# CONFIG_IOMMU_SUPPORT is not set
CONFIG_LFS_ON_32CPU=y
CONFIG_EXT2_FS=y
CONFIG_EXT3_FS=y
CONFIG_EXT4_FS=y
CONFIG_BTRFS_FS=y
CONFIG_VFAT_FS=y
CONFIG_TMPFS=y
CONFIG_TMPFS_POSIX_ACL=y
CONFIG_CONFIGFS_FS=y
CONFIG_ECRYPT_FS=y
CONFIG_UBIFS_FS=y
# CONFIG_NETWORK_FILESYSTEMS is not set
CONFIG_NLS_CODEPAGE_850=y
CONFIG_NLS_ISO8859_1=y
CONFIG_PRINTK_TIME=y
CONFIG_MESSAGE_LOGLEVEL_DEFAULT=7
CONFIG_DYNAMIC_DEBUG=y
CONFIG_DEBUG_INFO=y
CONFIG_MAGIC_SYSRQ=y
CONFIG_PANIC_ON_OOPS=y
CONFIG_ENABLE_DEFAULT_TRACERS=y
CONFIG_DEBUG_USER=y
CONFIG_DEBUG_LL=y
CONFIG_EARLY_PRINTK=y
CONFIG_KEYS=y
CONFIG_ENCRYPTED_KEYS=y
# CONFIG_CRYPTO_MANAGER_DISABLE_TESTS is not set
CONFIG_CRYPTO_CMAC=y
CONFIG_CRYPTO_MD4=y
CONFIG_CRYPTO_ARC4=y
CONFIG_CRYPTO_DEV_AL_CRYPTO=y
CONFIG_CRYPTO_DEV_AL_CRYPTO_STATS=y
CONFIG_LIBCRC32C=y
```

## linux-4.1.27-armada/Documentation/devicetree/bindings/crypto/mv_cesa.txt
```
Marvell Cryptographic Engines And Security Accelerator

Required properties:
- compatible: should be one of the following string
	      "marvell,orion-crypto"
	      "marvell,kirkwood-crypto"
	      "marvell,armada-370-crypto"
	      "marvell,armada-xp-crypto"
	      "marvell,armada-375-crypto"
	      "marvell,armada-38x-crypto"
- reg: base physical address of the engine and length of memory mapped
       region
- reg-names: "regs"
- interrupts: interrupt number
- clocks: reference to the crypto engines clocks. This property is not
	  required for orion and kirkwood platforms
- clock-names: "cesaX" and "cesazX", X should be replaced by the crypto engine
	       id.
	       This property is not required for the orion and kirkwoord
	       platforms.
	       "cesazX" clocks are not required on armada-370 platforms
- marvell,crypto-srams: phandle to crypto SRAM definitions

Optional properties:
- marvell,crypto-sram-size: SRAM size reserved for crypto operations, if not
			    specified the whole SRAM is used (2KB)

Deprecated properties:
- reg: base physical address of the engine and length of memory mapped
       region, followed by base physical address of sram and its memory
       length
- reg-names: "regs" , "sram"

Examples:

	crypto@90000 {
		compatible = "marvell,armada-xp-crypto";
		reg = <0x90000 0x10000>;
		reg-names = "regs";
		interrupts = <48>, <49>;
		clocks = <&gateclk 23>, <&gateclk 23>;
		clock-names = "cesa0", "cesa1";
		marvell,crypto-srams = <&crypto_sram0>, <&crypto_sram1>;
		marvell,crypto-sram-size = <0x600>;
		status = "okay";
	};
```

## linux-4.1.27-armada/drivers/platform/readynas/Kconfig
```kconfig
#
# Platform support for ReadyNAS hardware
#

menuconfig READYNAS_PLATFORMS
	bool "Platform support for ReadyNAS hardware"
	depends on X86 || ARM
	---help---
	  Say Y here to get to see options for platform support for
	  various ReadyNAS models. This option alone does not add any kernel code.

	  If you say N, all options in this submenu will be skipped and disabled.

if READYNAS_PLATFORMS

config HD44780_LCD
	tristate "Hitachi HD44780 LCD using GPIO"
	---help---
	  Say yes here to enable the alpha numeric LCD driver using
	  Hitachi HD44780 accessed by GPIO.

config READYNAS_LCD
	tristate "NETGEAR ReadyNAS LCD driver"
	depends on HD44780_LCD || READYNAS_IO
	---help---
	  Alpha numeric LCD driver for NETGEAR ReadyNAS.

config READYNAS_IO
	tristate "NETGEAR ReadyNAS/X86_64 HW UI IO drivers"
	depends on X86_64 && NETGEAR
	select GPIO_IT8732
	select GPIO_NCT6775
	---help---
	  Pseudo GPIO and button handling drivers for NETGEAR ReadyNAS/X86_64.

config READYNAS_LED
	tristate "NETGEAR ReadyNAS LED drivers"
	depends on READYNAS_IO
	select NEW_LEDS
	select LEDS_CLASS
	---help---
	  Disk and front panel LED drivers for NETGEAR ReadyNAS/X86_64.

config GPIO_PWR
	tristate "Turn off system power using GPIO"
	depends on OF_GPIO
	help
	  Say yes here to enable turning off system power using GPIO.

endif # READYNAS_PLATFORMS
```

## linux-4.4.218-alpine/Documentation/devicetree/bindings/misc/hd44780-lcd.txt
```
Driver to drive Hitachi HD44780 based LCD displays through GPIO lines.

This is a generic HD44780-based LCD driver not using GPIO.

Required properties:
- compatible : should be "gpio-lcd" or "hd44780-lcd".
- lcm-bits : an array of 4 or 8 GPIO line references. The 3rd argument
  (polarity or active high/low) is honored.
  lcm-en, lcm-rs, lcm-rw : GPIO line references to the corresponding
  HD44780 signals, EN, RS, and RW.
  lcm-bl : a GPIO line reference to control LCD backlight.
  locm-data-4bit : a boolean property to indicate 4-bit data mode.

Optional properties:
- lcm-lines : the number of LCD lines (default is 2). The HD44780 does not
  support more than 2 lines.
- lcm-cols : the number of LCD columns. Currently ignored.

Example:

gpio_lcd: gpio_lcd {
	compatible = "gpio-lcd";
	lcm-data-4bit;
	lcm-lines  = <2>;
	lcm-bits = <&gpio4 4 0>,
		   <&gpio4 5 0>,
		   <&gpio4 6 0>,
		   <&gpio4 7 0>;
	lcm-rs   = <&gpio4 3 0>;
	lcm-bl   = <&gpio5 0 0>;
	lcm-rw   = <&gpio5 1 0>;
	lcm-en   = <&gpio5 2 0>;
};
```

## linux-4.4.218-alpine/Documentation/devicetree/bindings/misc/readynas-lcd.txt
```
Driver to implement NETGEAR ReadyNAS's LCD user land API over the procfs
using the Hitachi HD44780 based LCD driver "gpio-lcd."

This driver creates the following /proc entries:
/proc/LCD : 'echo 1 \"Hello\" > /proc/LCD' displays "Hello" on line #1.
          : 'echo 2 \"World\" > /proc/LCD' displays "World" on line #2.
          : 'echo 3 > /proc/LCD' turns LCD on.
          : 'echo 4 > /proc/LCD' turns LCD off.
          : 'echo 0 > /proc/LCD' clears LCD.
/proc/LCDstatus : a read-only entry to return LCD on/off status.
/proc/LCDinfo : a read-only entry to return LCD information

Required properties:
- compatible : should be "readynas-lcd."
- lcd-device : a reference to the HD33780 device.

Example:

readynas_lcd {
	compatible = "readynas-lcd";
	lcd-device = <&gpio_lcd>;
};
```
