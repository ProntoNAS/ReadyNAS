## buildroot-2014.08/configs/readynasos-x86_64_defconfig
```kconfig
BR2_x86_64=y
BR2_JLEVEL=16
BR2_KERNEL_HEADERS_3_12=y
BR2_TOOLCHAIN_BUILDROOT_LARGEFILE=y
BR2_TOOLCHAIN_BUILDROOT_INET_IPV6=y
BR2_TOOLCHAIN_BUILDROOT_INET_RPC=y
BR2_TOOLCHAIN_BUILDROOT_LOCALE=y
# BR2_UCLIBC_INSTALL_UTILS is not set
BR2_BINUTILS_VERSION_2_24=y
BR2_GCC_VERSION_4_9_X=y
BR2_TOOLCHAIN_BUILDROOT_CXX=y
BR2_TARGET_GENERIC_HOSTNAME="readynasos"
BR2_TARGET_GENERIC_ISSUE="Welcome to ReadyNASOS"
BR2_ROOTFS_DEVICE_CREATION_DYNAMIC_MDEV=y
BR2_ROOTFS_SKELETON_CUSTOM=y
BR2_ROOTFS_SKELETON_CUSTOM_PATH="custom/skeleton"
BR2_ROOTFS_POST_BUILD_SCRIPT="custom/customize-x86_64.sh"
BR2_PACKAGE_BUSYBOX_CONFIG="custom/config-initrd"
BR2_PACKAGE_BUSYBOX_SHOW_OTHERS=y
BR2_PACKAGE_KEXEC=y
BR2_PACKAGE_BTRFS_PROGS=y
BR2_PACKAGE_DOSFSTOOLS=y
BR2_PACKAGE_DOSFSTOOLS_FSCK_FAT=y
# BR2_PACKAGE_E2FSPROGS_BADBLOCKS is not set
# BR2_PACKAGE_E2FSPROGS_DUMPE2FS is not set
# BR2_PACKAGE_E2FSPROGS_E2FREEFRAG is not set
# BR2_PACKAGE_E2FSPROGS_E2UNDO is not set
# BR2_PACKAGE_E2FSPROGS_FILEFRAG is not set
# BR2_PACKAGE_E2FSPROGS_FINDFS is not set
# BR2_PACKAGE_E2FSPROGS_FSCK is not set
# BR2_PACKAGE_E2FSPROGS_LOGSAVE is not set
# BR2_PACKAGE_E2FSPROGS_LSATTR is not set
# BR2_PACKAGE_E2FSPROGS_MKLOSTFOUND is not set
# BR2_PACKAGE_E2FSPROGS_UUIDGEN is not set
BR2_PACKAGE_DDRESCUE=y
BR2_PACKAGE_DMIDECODE=y
BR2_PACKAGE_GPTFDISK=y
BR2_PACKAGE_GPTFDISK_SGDISK=y
BR2_PACKAGE_HDPARM=y
BR2_PACKAGE_LM_SENSORS=y
# BR2_PACKAGE_LM_SENSORS_SENSORS is not set
BR2_PACKAGE_LVM2=y
BR2_PACKAGE_MDADM=y
BR2_PACKAGE_MEMTESTER=y
BR2_PACKAGE_SG3_UTILS=y
BR2_PACKAGE_SMARTMONTOOLS=y
BR2_PACKAGE_SQLITE=y
BR2_PACKAGE_LIBCURL=y
BR2_PACKAGE_LLCONF=y
BR2_PACKAGE_DROPBEAR=y
BR2_PACKAGE_DROPBEAR_DISABLE_REVERSEDNS=y
BR2_PACKAGE_DTACH=y
BR2_PACKAGE_UTIL_LINUX_BINARIES=y
```

## buildroot-2014.08/package/ddrescue/Config.in
```kconfig
config BR2_PACKAGE_DDRESCUE
	bool "ddrescue"
	depends on BR2_LARGEFILE
	depends on BR2_USE_WCHAR # util-linux
	help
	  Ddrescue - Data recovery tool

	  http://www.gnu.org/software/ddrescue/ddrescue.html

comment "ddrescue requires a toolchain with LARGEFILE + WCHAR support"
	depends on !(BR2_LARGEFILE && BR2_USE_WCHAR)
```

## buildroot-2015.11.1/package/ddrescue/Config.in
```kconfig
config BR2_PACKAGE_DDRESCUE
	bool "ddrescue"
	depends on BR2_USE_WCHAR # util-linux
	help
	  Ddrescue - Data recovery tool

	  http://www.gnu.org/software/ddrescue/ddrescue.html

comment "ddrescue needs a toolchain w/ wchar"
	depends on !BR2_USE_WCHAR
```

## buildroot-2015.11.1/package/llconf/Config.in
```kconfig
config BR2_PACKAGE_LLCONF
	bool "llconf"
	help
	  Lossless configuration file parser library

	  http://code.google.com/p/llconf/
```

## linux-2.6.17.14/arch/padre/Kconfig
```kconfig
#
# For a description of the syntax of this configuration file,
# see Documentation/kbuild/kconfig-language.txt.
#

mainmenu "Linux Kernel/Padre Configuration"

config SPARC
        bool
        default y

# Identify this as a Sparc32 build
config SPARC32
        bool
        default y

config PADRE
	bool
	default y

config MMU
	bool
	default y


source "init/Kconfig"

source "kernel/Kconfig.preempt"
source "kernel/Kconfig.hz"

menu "General setup for PADRE"

config PADRE_NONCACHESIZE
	int "Non-cacheable area for DMA (in 16Mbyte units)"
	help
	  this number is mutiple by 16M

config PADRE_STACK_16K
	bool "support 16K kernel stack"

choice
	prompt "padre page size"
	default PADRE_4K_PAGE

	config PADRE_4K_PAGE
		bool "support 4k page size"

	config PADRE_8K_PAGE
		bool "support 8k page size"

	config PADRE_16K_PAGE
		bool "support 16k page size"

	config PADRE_RESERVE_DMA
		bool "reserve DMA memory for page table"
		depends PADRE_16K_PAGE
		
endchoice

#config PADRE_BLK
#	bool "padre blk device support"

#config BLK_DEV_PADREDISK
#	bool
#	default y	

config RWSEM_GENERIC_SPINLOCK
	bool
	default y

config RWSEM_XCHGADD_ALGORITHM
        bool

config GENERIC_FIND_NEXT_BIT
        bool
        default y

config GENERIC_HWEIGHT
        bool
        default y

config GENERIC_CALIBRATE_DELAY
        bool
        default y

config PADRE_SERIAL
        bool
	default y
	
config PADRE_SERIAL_CONSOLE
        bool
	default y

config SERIAL_CORE
        bool
	default y

config SERIAL_CORE_CONSOLE
        bool
	default y

config UNIX98_PTYS
	bool
	default y
	

config OBSOLETE_INTERMODULE
	bool
	default y

config LBD
	bool
	default y

config PCI
	bool 
	default y


source "drivers/pci/Kconfig"

source "fs/Kconfig.binfmt"

source "mm/Kconfig"

endmenu

menu "Padre debug message and system patch"

config PADRE_64BIT
        int "Support 64 bit in PADRE"

config PADRE_UNEXPECT_TLBTRAP
	bool "PADRE chip can generate unexpect tlb trap"
	help
		turn on this option will cause debug message if our sofeware patch
		failure.

config PADRE_UNALIGNED
	bool "Turn on register and stack dump for unaligned acess"

config PADRE_BUG179
	bool "Turn on bug 179 fix and trace"
	default n
	help
	  Turn on debug message for bug 179

config PADRE_BUG893
	bool "Turn on bug 893 fix and trace"
	default y
	help
	  Turn on debug message for bug 893

config PADRE_DIV_BUG
        bool "Turn on bug 940(divide) fix and trace"
        default y
        help
          Turn on debug message for bug 940

endmenu

menu "Device support for padre"

config PADRE_FLASH
        bool "Padre flash device support"
        select MTD
        select MTD_COMPLEX_MAPPINGS
        select MTD_PARTITIONS
        select MTD_CHAR
        select MTD_BLOCK
        select MTD_MAP_BANK_WIDTH_1
        select MTD_CFI
        select MTD_GEN_PROBE
        select MTD_CFI_INTELEXT
        select MTD_CFI_AMDSTD
        select MTD_CFI_I1
        select MTD_CFI_UTIL
        select MTD_ATMEL
        select MTD_NAND
        select MTD_NAND_ECC
        select MTD_NAND_VERIFY_WRITE
        select MTD_NAND_IDS

config MTD
	bool
config MTD_COMPLEX_MAPPINGS
	bool
config MTD_PARTITIONS
	bool
config MTD_CHAR
	bool
config MTD_BLOCK
	bool
config MTD_MAP_BANK_WIDTH_1
	bool
config MTD_CFI
	bool
config MTD_GEN_PROBE
	bool
config MTD_CFI_INTELEXT
	bool
config MTD_CFI_AMDSTD
	bool
config MTD_CFI_I1
	bool
config MTD_CFI_UTIL
	bool
config MTD_ATMEL
	bool
config MTD_NAND
	bool
config MTD_NAND_VERIFY_WRITE
	bool
config MTD_NAND_IDS
	bool

config MTD_DEBUG
	bool "MTD debugging"
	depends on MTD

config MTD_DEBUG_VERBOSE
        int "Debugging verbosity (0 = quiet, 3 = noisy)"
        depends on MTD_DEBUG
        default "0"
        help
          Determines the verbosity level of the MTD debugging messages.
	
endmenu

source "net/Kconfig"
source "drivers/net/Kconfig"

source "drivers/base/Kconfig"

source "drivers/block/Kconfig"

# source "drivers/mtd/Kconfig"

source "drivers/ide/Kconfig"

source "drivers/scsi/Kconfig"

source "drivers/md/Kconfig"

# This one must be before the filesystem configs. -DaveM

source "fs/Kconfig"

menu "Instrumentation Support"
source "arch/padre/oprofile/Kconfig"
endmenu

source "drivers/usb/Kconfig"

source "arch/padre/Kconfig.debug"

source "security/Kconfig"

source "crypto/Kconfig"

source "lib/Kconfig"
```

## linux-2.6.17.14/arch/padre/Kconfig.debug
```kconfig
menu "Kernel hacking"

source "lib/Kconfig.debug"

config DEBUG_STACKOVERFLOW
        bool "Check for stack overflows"
        depends on DEBUG_KERNEL
        help
          This option will cause messages to be printed if free stack space
          drops below a certain limit.

config KPROBES
        bool "Kprobes"
        depends on DEBUG_KERNEL
        help
          Kprobes allows you to trap at almost any kernel address and
          execute a callback function.  register_kprobe() establishes
          a probepoint and specifies the callback.  Kprobes is useful
          for kernel debugging, non-intrusive instrumentation and testing.
          If in doubt, say "N".

config DEBUG_STACK_USAGE
	bool "Enable stack utilization instrumentation"
	depends on DEBUG_KERNEL
	help
	  Enables the display of the minimum amount of free stack which each
	  task has ever had available in the sysrq-T and sysrq-P debug output.

	  This option will slow down process creation somewhat.

config DEBUG_PAGEALLOC
        bool "Page alloc debugging"
        depends on DEBUG_KERNEL && !SOFTWARE_SUSPEND
        help
          Unmap pages from the kernel linear mapping after free_pages().
          This results in a large slowdown, but helps to find certain types
          of memory corruptions.

endmenu
```

## linux-2.6.31.8/drivers/pwrctl/Kconfig
```kconfig
menu "USI MV88F6281 HDD Power Control"

config USI_POWER_CTL
	tristate "NAS MV88F6281 HDD Power Control Support"
	depends on MV88F6281
	default y
	help
	  Select this option to enable the Fan Control with pwm (gpio) support 
	  support on the NAS Topkick unit.

endmenu
```

## linux-3.0.101-0.46-rn2120/arch/arm/plat-armada/mv_drivers_lsp/mv_phone/Kconfig
```kconfig
menu "Telephony options"
	depends on MV_INCLUDE_TDM

config  MV_PHONE
	bool "Support for Marvell telephony(VoIP)"
	depends on MV_INCLUDE_TDM && PHONE
	default m
	---help---
	  Choosing this option enables the Marvell telephony underlying 
	  support for various VoIP applications. 
	  Note, kernel Telephony subsystem must be chosen too.

choice 
	prompt "TDM unit"
	depends on MV_PHONE

config MV_TDM_SUPPORT
	bool "Support legacy TDM(2 channels)"

config MV_COMM_UNIT_SUPPORT
	depends on ARCH_FEROCEON_KW2
	bool "Support CommUnit(up to 32 channels)"

endchoice

choice 
	prompt "SLIC vendor"
	depends on MV_PHONE

config SILABS_SLIC_SUPPORT
	bool "Support Silicon Labs devices"

config ZARLINK_SLIC_SUPPORT
	bool "Support Zarlink/Legirity devices"

endchoice

choice 
	prompt "SLIC type"
	depends on MV_PHONE && SILABS_SLIC_SUPPORT

config SILABS_SLIC_3215
	bool "Support Silicon Labs 3215 device"

config SILABS_SLIC_3217
	bool "Support Silicon Labs 3217 device"

endchoice

choice 
	prompt "SLIC type"
	depends on MV_PHONE && ZARLINK_SLIC_SUPPORT

config ZARLINK_SLIC_VE880
	bool "Support Zarlink VE880 SLIC family"

config ZARLINK_SLIC_VE792
	bool "Support Zarlink VE792 SLIC family"

endchoice


config MV_TDM_USE_EXTERNAL_PCLK_SOURCE
	bool "Support PCLK from external source"
	depends on MV_PHONE
	default n
	---help---
	Choosing this option enables TDM unit to use PCLK supplied by external source.

config TDM_DEV_TEST_SUPPORT
	bool "Support tdm testing"
	depends on MV_INCLUDE_TDM
	help
	   The tdm testing device supports several basic telephony tests on Marvell TDM based platforms.

config MV_PHONE_USE_SLIC_LIBS
	bool "Use binary slic drivers"
	default y
	---help---
	Unselect this option only if you have source code of slic drivers.
	If unsure, say "y"

config MV_COMM_UNIT_FSYNC_STRB_SUPPORT
	bool "Use CommUnit strobe pin as frame sync source"
	default y
	depends on MV_COMM_UNIT_SUPPORT
	help
	  The CommUnit frame sync 1/2/3 bit delay feature is not working in Z1 silicon revision, therefore
	  the strobe pin can be used as tunable frame sync source.

endmenu
```

## linux-3.0.101-0.46-rn2120/drivers/input/misc/smtc/Kconfig
```kconfig
#
# Input misc drivers configuration for SX8636
#
#	depends on I2C && I2C_I801
menu "Semtech Capacitive Touch Sensors"

config INPUT_SX8635
	tristate "Semtech SX8635"
	depends on I2C_I801
	help
	  Say Y here if you want to use the SX8635 for Capacitive Buttons/Wheel.

	  To compile this driver as a module, choose M here: the
	  module will be called sx8635.


endmenu
```

## linux-3.0.101-0.46-rn2120/drivers/net/ethernet/Kconfig
```kconfig
#
# Ethernet LAN device configuration
#

menuconfig ETHERNET
	bool "Ethernet driver support"
	depends on NET
	default y
	---help---
	  This section contains all the Ethernet device drivers.

if ETHERNET

source "drivers/net/ethernet/broadcom/Kconfig"
source "drivers/net/ethernet/brocade/Kconfig"
source "drivers/net/ethernet/chelsio/Kconfig"
source "drivers/net/ethernet/cisco/Kconfig"
source "drivers/net/ethernet/emulex/Kconfig"
source "drivers/net/ethernet/intel/Kconfig"
source "drivers/net/ethernet/mellanox/Kconfig"
source "drivers/net/ethernet/qlogic/Kconfig"
source "drivers/net/ethernet/sfc/Kconfig"

endif # ETHERNET
```

## linux-3.0.101-0.46-rn2120/drivers/net/ethernet/broadcom/Kconfig
```kconfig
#
# Broadcom device configuration
#

config NET_VENDOR_BROADCOM
	bool "Broadcom devices"
	depends on (SSB_POSSIBLE && HAS_DMA) || PCI || BCM63XX || \
		   SIBYTE_SB1xxx_SOC
	---help---
	  If you have a network (Ethernet) chipset belonging to this class,
	  say Y.

	  Note that the answer to this question does not directly affect
	  the kernel: saying N will just case the configurator to skip all
	  the questions regarding AMD chipsets. If you say Y, you will be asked
	  for your specific chipset/driver in the following questions.

if NET_VENDOR_BROADCOM

config BNX2
	tristate "Broadcom NetXtremeII support"
	depends on PCI
	select CRC32
	select FW_LOADER
	help
	  This driver supports Broadcom NetXtremeII gigabit Ethernet cards.

	  To compile this driver as a module, choose M here: the module
	  will be called bnx2.  This is recommended.

config CNIC
	tristate "Broadcom CNIC support"
	depends on PCI
	select BNX2
	select UIO
	help
	  This driver supports offload features of Broadcom NetXtremeII
	  gigabit Ethernet cards.

	  To compile this driver as a module, choose M here: the module
	  will be called cnic.  This is recommended.

config TIGON3
	tristate "Broadcom Tigon3 support"
	depends on PCI
	select PHYLIB
	select HWMON
	select PTP_1588_CLOCK
	---help---
	  This driver supports Broadcom Tigon3 based gigabit Ethernet cards.

	  To compile this driver as a module, choose M here: the module
	  will be called tg3.  This is recommended.

config BNX2X
	tristate "Broadcom NetXtremeII 10Gb support"
	depends on PCI
	select FW_LOADER
	select ZLIB_INFLATE
	select LIBCRC32C
	select MDIO
	---help---
	  This driver supports Broadcom NetXtremeII 10 gigabit Ethernet cards.
	  To compile this driver as a module, choose M here: the module
	  will be called bnx2x.  This is recommended.

endif # NET_VENDOR_BROADCOM
```

## linux-3.0.101-0.46-rn2120/drivers/virtio/Kconfig
```kconfig
config VIRTIO
	tristate
	---help---
	  This option is selected by any driver which implements the virtio
	  bus, such as CONFIG_VIRTIO_PCI, CONFIG_VIRTIO_MMIO, CONFIG_LGUEST,
	  CONFIG_RPMSG or CONFIG_S390_GUEST.

menu "Virtio drivers"
	depends on !XEN

config VIRTIO_PCI
	tristate "PCI driver for virtio devices (EXPERIMENTAL)"
	depends on PCI && EXPERIMENTAL
	select VIRTIO
	---help---
	  This drivers provides support for virtio based paravirtual device
	  drivers over PCI.  This requires that your VMM has appropriate PCI
	  virtio backends.  Most QEMU based VMMs should support these devices
	  (like KVM or Xen).

	  Currently, the ABI is not considered stable so there is no guarantee
	  that this version of the driver will work with your VMM.

	  If unsure, say M.

config VIRTIO_BALLOON
	tristate "Virtio balloon driver"
	depends on VIRTIO
	---help---
	 This driver supports increasing and decreasing the amount
	 of memory within a KVM guest.

	 If unsure, say M.

 config VIRTIO_MMIO
 	tristate "Platform bus driver for memory mapped virtio devices (EXPERIMENTAL)"
 	depends on HAS_IOMEM && EXPERIMENTAL
 	select VIRTIO
 	---help---
 	 This drivers provides support for memory mapped virtio
	 platform device driver.

 	 If unsure, say N.

endmenu
```
